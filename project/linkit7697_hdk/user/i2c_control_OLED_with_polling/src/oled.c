
#include <stdlib.h>
#include "hal.h"
#include "oled.h"

static const uint8_t BasicFont[][8] = {
    {0x00,0x00,0x00,0x00,0x00,0x00,0x00,0x00},
    {0x00,0x00,0x5F,0x00,0x00,0x00,0x00,0x00},
    {0x00,0x00,0x07,0x00,0x07,0x00,0x00,0x00},
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    {0x00,0x02,0x05,0x05,0x02,0x00,0x00,0x00}
};

static void (*__OLED_Delay)(uint32_t msec);

#define OLED_Delay(msec)    \
            __OLED_Delay(msec)

#define OLED_ARRAY_SIZE(arr)    \
            sizeof(arr)/sizeof(arr[0])

#define OLED_SendStream(oled, stream)  \
            oled->sender(stream, OLED_ARRAY_SIZE(stream))

void OLED_SendCommand(oled_t *oled, uint8_t cmd)
{
    uint8_t buffer[2] = { OLED_Command_Mode, cmd };
    OLED_SendStream(oled, buffer);
}

void OLED_SendData(oled_t *oled, uint8_t data)
{
    uint8_t buffer[2] = { OLED_Data_Mode, data };
    OLED_SendStream(oled, buffer);
}

void OLED_SetPageMode(oled_t *oled)
{
    oled->addressingMode = PAGE_MODE;

    OLED_SendCommand(oled, 0x20);
    OLED_SendCommand(oled, 0x02);
}

void OLED_SetHorizontalMode(oled_t *oled)
{
    oled->addressingMode = HORIZONTAL_MODE;

    OLED_SendCommand(oled, 0x20);
    OLED_SendCommand(oled, 0x00);
}

void OLED_SetTextXY(oled_t *oled, uint8_t Row, uint8_t Column)
{
    OLED_SendCommand(oled, 0xB0 + Row);
    OLED_SendCommand(oled, 0x00 + ((Column << 3) & 0x0f));
    OLED_SendCommand(oled, 0x10 + ((Column >> 1) & 0x0f));
}

void OLED_PutChar(oled_t *oled, uint8_t c)
{
    uint8_t i = 0;

    if(c < 32 || c > 127) { //Ignore non-printable ASCII characters. This can be modified for multilingual font.
        c = ' '; //Space
    }
    
    for(i = 0; i < 8; i++) {
       //read bytes from code memory
       uint8_t a = BasicFont[c - 32][i];
       OLED_SendData(oled, a); //font array starts at 0, ASCII starts at 32. Hence the translation
    }
}

void OLED_PutString(oled_t *oled, const char *str)
{
    while(*str) {
        OLED_PutChar(oled, *str);
        str++;
    }
}

uint8_t OLED_PutNumber(oled_t *oled, long n)
{
    uint8_t char_buffer[10] = "";
    uint8_t i = 0;
    uint8_t f = 0;

    if (n < 0) {
        f=1;
        OLED_PutChar(oled, '-');
        n = -n;
    } else if (n == 0) {
        f=1;
        OLED_PutChar(oled, '0');
        return f;
    }

    while (n > 0) {
        char_buffer[i++] = n % 10;
        n /= 10;
    }

    f = f + i;
    for(; i > 0; i--) {
        OLED_PutChar(oled, '0'+ char_buffer[i - 1]);
    }

    return f;
}

void OLED_ClearDisplay(oled_t *oled)
{
    uint8_t i,j;
    OLED_SendCommand(oled, OLED_Display_Off_Cmd);   //display off
    for(j = 0; j < 8;j++) {
        OLED_SetTextXY(oled, j, 0);
        for(i = 0; i < 16; i++) {  //clear all columns
            OLED_PutChar(oled, ' ');
        }
    }
    OLED_SendCommand(oled, OLED_Display_On_Cmd);    //display on
    OLED_SetTextXY(oled, 0,0);
}

void OLED_SetBrightness(oled_t *oled, uint8_t Brightness)
{
    OLED_SendCommand(oled, OLED_Set_Brightness_Cmd);
    OLED_SendCommand(oled, Brightness);
}

uint8_t OLED_PutFloat(oled_t *oled, float floatNumber, uint8_t decimal)
{
    uint32_t temp=0;
    float decy=0.0;
    float rounding = 0.5;
    uint8_t f=0;
    if(floatNumber < (float)0.0) {
        OLED_PutString(oled, "-");
        floatNumber = -floatNumber;
        f += 1;
    }
    for (uint8_t i=0; i < decimal; ++i) {
        rounding /= (float)10.0;
    }
    floatNumber += rounding;

    temp = floatNumber;
    f += OLED_PutNumber(oled, temp);
    if(decimal>0) {
        OLED_PutChar(oled, '.');
        f +=1;
    }
    decy = floatNumber - temp;//decimal part,
    for(uint8_t i=0; i < decimal; i++) {//4
        decy *= 10;// for the next decimal
        temp = decy;//get the decimal
        OLED_PutNumber(oled, temp);
        decy -= temp;
    }
    f += decimal;

    return f;
}

void OLED_DrawBitmap(oled_t *oled, uint8_t *bitmaparray, int32_t bytes)
{
    char localAddressMode = oled->addressingMode;

    if(oled->addressingMode != HORIZONTAL_MODE) {
        //Bitmap is drawn in horizontal mode
        OLED_SetHorizontalMode(oled);
    }

    for(int32_t i=0;i<bytes;i++) {
        OLED_SendData(oled, bitmaparray[i]);
    }

    if(localAddressMode == PAGE_MODE) {
        //If pageMode was used earlier, restore it.
        OLED_SetPageMode(oled);
    }
}

void OLED_SetHorizontalScrollProperties(
    oled_t *oled,
    uint8_t direction, 
    uint8_t startPage, 
    uint8_t endPage, 
    uint8_t scrollSpeed)
{

    if(Scroll_Right == direction) {
        //Scroll Right
        OLED_SendCommand(oled, 0x26);
    } else {
        //Scroll Left
        OLED_SendCommand(oled, 0x27);
    }
    OLED_SendCommand(oled, 0x00);
    OLED_SendCommand(oled, startPage);
    OLED_SendCommand(oled, scrollSpeed);
    OLED_SendCommand(oled, endPage);
    OLED_SendCommand(oled, 0x00);
    OLED_SendCommand(oled, 0xFF);
}

void OLED_ActivateScroll(oled_t *oled)
{
    OLED_SendCommand(oled, OLED_Activate_Scroll_Cmd);
}

void OLED_DeactivateScroll(oled_t *oled)
{
    OLED_SendCommand(oled, OLED_Dectivate_Scroll_Cmd);
}

void OLED_SetNormalDisplay(oled_t *oled)
{
    OLED_SendCommand(oled, OLED_Normal_Display_Cmd);
}

void OLED_SetInverseDisplay(oled_t *oled)
{
    OLED_SendCommand(oled, OLED_Inverse_Display_Cmd);
}


void OLED_Init(oled_t *oled)
{
    OLED_SendCommand(oled, OLED_Display_Off_Cmd);
    OLED_Delay(5);
    OLED_SendCommand(oled, OLED_Display_On_Cmd);
    OLED_Delay(5);
    OLED_SendCommand(oled, OLED_Normal_Display_Cmd);
}

static const struct oled_opt_s __oled_opt = {
    .drawBitmap                    = OLED_DrawBitmap,
    .setHorizontalMode             = OLED_SetHorizontalMode,
    .setPageMode                   = OLED_SetPageMode,
    .init                          = OLED_Init,
    .clearDisplay                  = OLED_ClearDisplay,
    .deactivateScroll              = OLED_DeactivateScroll,
    .putChar                       = OLED_PutChar,
    .putString                     = OLED_PutString,
    .putFloat                      = OLED_PutFloat,
    .putNumber                     = OLED_PutNumber,
    .sendCommand                   = OLED_SendCommand,
    .sendData                      = OLED_SendData,
    .setBrightness                 = OLED_SetBrightness,
    .setHorizontalScrollProperties = OLED_SetHorizontalScrollProperties,
    .setInverseDisplay             = OLED_SetInverseDisplay,
    .setNormalDisplay              = OLED_SetNormalDisplay,
    .setTextXY                     = OLED_SetTextXY,
    .activateScroll                = OLED_ActivateScroll,
};

void OLED_HardwareInit(void (*delay)(uint32_t msec))
{
    __OLED_Delay = delay;
}


#ifdef NO_MALLOC_SUPPORT

    oled_t *OLED_New(oled_t *oled, void (*send)(uint8_t*, uint16_t))
    {
        oled->addressingMode = 0;
        oled->opt = (struct oled_opt_t *)&__oled_opt;
        oled->sender = send;

        return oled;
    }

#else

    oled_t *OLED_New(void (*send)(uint8_t*, uint16_t))
    {
        oled_t *oled = (oled_t *)malloc(sizeof(oled_t));
        oled->addressingMode = 0;
        oled->opt = (struct oled_opt_t *)&__oled_opt;
        oled->sender = send;

        return oled;
    }

    void OLED_Free(oled_t *oled)
    {
        free(oled);
    }

#endif
